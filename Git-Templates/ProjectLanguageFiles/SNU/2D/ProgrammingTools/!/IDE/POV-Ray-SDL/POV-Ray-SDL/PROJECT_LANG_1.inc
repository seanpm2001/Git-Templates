// Start of script

// Project language file 1
// For: SNU/2D/ProgrammingTools/IDE/POV-Ray-SDL
// About:
// I decided to make POV-Ray SDL the main project language file for this project (SNU / 2D / Programming Tools / IDE / POV-Ray-SDL) as this is a POV-Ray SDL IDE, and it needs its main language to be represented here.

#macro plang1
	#declare title "Project language file 1"
	#declare subti "For: seanpm2001/Learn-POV-Ray-SDL"
	#declare about "About: "
	#declare descr "I decided to make POV-Ray SDL the main project language file for this project (SNU / 2D / Programming Tools / IDE / POV-Ray-SDL) as this is a POV-Ray SDL IDE, and it needs its main language to be represented here."
#end

// File info
// File type: POV-Ray-SDL source file (*.inc)
// File version: 1 (2022, Monday, October 3rd at 11:02 pm PST)
// Line count (including blank lines and compiler line): 21

// End of script
