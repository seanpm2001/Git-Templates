// Start of script

// Project language file 1
// For: seanpm2001/Learn-POV-Ray-SDL
// About:
// I decided to make POV-Ray SDL the main project language file for this project (Seanpm2001/Learn-POV-Ray-SDL) as POV-Ray SDL is the language this project is dedicated to, because this project is about learning the POV-Ra SDL programming language. It only makes sense to POV-Ray SDL the official language for this project. It is getting its own project language file, starting here.

#macro plang1
	#declare title "Project language file 1"
	#declare subti "For: seanpm2001/Learn-POV-Ray-SDL"
	#declare about "About: "
	#declare descr "I decided to make POV-Ray SDL the main project language file for this project (Seanpm2001/Learn-POV-Ray-SDL) as POV-Ray SDL is the language this project is dedicated to, because this project is about learning the POV-Ray SDL programming language. It only makes sense to POV-Ray SDL the official language for this project. It is getting its own project language file, starting here."
#end

// File info
// File type: POV-Ray-SDL source file (*.inc)
// File version: 1 (2022, Monday, October 3rd at 10:55 pm PST)
// Line count (including blank lines and compiler line): 21

// End of script
